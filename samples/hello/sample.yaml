## samples/hello/sample.yaml
```yaml
sample:
  name: mruby/c Hello World
tests:
  sample.mrubyc.hello:
    tags: mrubyc
    platform_allow: [native_sim, qemu_cortex_m3]
    harness: console
    harness_config:
      type: multi_line
      ordered: true
      regex:
        - 'Hello from mruby/c on Zephyr!'
        - 'mruby/c finished'
```

## samples/vm_tasks/sample.yaml
```yaml
sample:
  name: mruby/c task scheduling
tests:
  sample.mrubyc.vm_tasks:
    tags: mrubyc
    platform_allow: [native_sim, qemu_cortex_m3]
    harness: console
    harness_config:
      type: multi_line
      ordered: true
      regex:
        - 'a:start'
        - 'b:ran'
        - 'a:done'
        - 'Scheduler returned 0'
```

## tests/fatal_hooks/testcase.yaml
```yaml
common:
  tags: mrubyc
  harness: console
  ignore_faults: true
  platform_allow: [native_sim, qemu_cortex_m3]
  timeout: 10
tests:
  mrubyc.fatal_hooks.oom_default:
    extra_args: TRIGGER_OOM=ON
    harness_config:
      type: multi_line
      regex:
        - 'Fatal error: Out of memory\.'
        - 'Pool statistics printed: no'
        - 'Caught Zephyr kernel panic'
  mrubyc.fatal_hooks.oom_pool_stats:
    extra_args: TRIGGER_OOM=ON
    extra_configs:
      - CONFIG_MRUBYC_OOM_POOL_STATS=y
      - CONFIG_MRUBYC_INT64=y
    harness_config:
      type: multi_line
      regex:
        - 'mruby/c pool: total=16384 used=[0-9]+ free=[0-9]+ bytes'
        - 'Fatal error: Out of memory\.'
        - 'Pool statistics printed: yes'
        - 'Caught Zephyr kernel panic'
  mrubyc.fatal_hooks.exception_default:
    harness_config:
      type: multi_line
      regex:
        - 'Rescued exception'
        - 'unhandled test exception'
        - 'Scheduler returned the unhandled exception status'
  mrubyc.fatal_hooks.panic_on_exception:
    extra_configs:
      - CONFIG_MRUBYC_PANIC_ON_UNHANDLED_EXCEPTION=y
    harness_config:
      type: multi_line
      regex:
        - 'Rescued exception'
        - 'unhandled test exception'
        - 'Caught Zephyr kernel panic'
  mrubyc.fatal_hooks.dynamic_task_exception:
    extra_args: USE_DYNAMIC_TASK=ON
    extra_configs:
      - CONFIG_MRUBYC_PANIC_ON_UNHANDLED_EXCEPTION=y
    harness_config:
      type: multi_line
      regex:
        - 'Rescued exception'
        - 'Dynamic task joined'
        - 'Scheduler returned the unhandled exception status'
```

## tests/mrubyc/testcase.yaml
```yaml
common:
  tags: mrubyc
  harness: ztest
  timeout: 30
tests:
  mrubyc.integration.defaults:
    platform_allow: [native_sim, qemu_cortex_m3]
    extra_args: EXPECT_DEFAULTS=ON
  mrubyc.integration.no_op_ext:
    platform_allow: [native_sim, qemu_cortex_m3]
    extra_configs:
      - CONFIG_MRUBYC_SUPPORT_OP_EXT=n
  mrubyc.integration.trap_unaligned:
    platform_allow: qemu_cortex_m3
    extra_configs:
      - CONFIG_TRAP_UNALIGNED_ACCESS=y
  mrubyc.integration.custom:
    platform_allow: [native_sim, qemu_cortex_m3]
    extra_configs:
      - CONFIG_MRUBYC_MAX_VM_COUNT=3
      - CONFIG_MRUBYC_MAX_REGS_SIZE=64
      - CONFIG_MRUBYC_MAX_SYMBOLS_COUNT=320
      - CONFIG_MRUBYC_FLOAT_SINGLE=y
      - CONFIG_MRUBYC_USE_MATH=y
      - CONFIG_MRUBYC_INT64=y
      - CONFIG_MRUBYC_USE_STRING_UTF8=y
      - CONFIG_MRUBYC_USE_UNICODE_CASE=y
      - CONFIG_MRUBYC_SYMBOL_SEARCH_LINEAR=y
      - CONFIG_MRUBYC_INSTANCE_DESTRUCTOR=n
      - CONFIG_MRUBYC_EXCEPTION_CALL_NEST_LEVEL=1
      - CONFIG_MRUBYC_TASK_NAME_LEN=24
      - CONFIG_MRUBYC_KV_SIZE_INIT=3
      - CONFIG_MRUBYC_KV_SIZE_INCREMENT=4
      - CONFIG_MRUBYC_TICK_UNIT_MS=4
      - CONFIG_MRUBYC_TIMESLICE_TICK_COUNT=3
  mrubyc.integration.scheduler_idle:
    platform_allow: [native_sim, qemu_cortex_m3]
    extra_configs:
      - CONFIG_MRUBYC_SCHEDULER_EXIT=n
  mrubyc.integration.libc_nan_boxing:
    platform_allow: [native_sim, qemu_cortex_m3]
    extra_configs:
      - CONFIG_MRUBYC_ALLOC_LIBC=y
      - CONFIG_MRUBYC_NAN_BOXING=y
      - CONFIG_MRUBYC_STRING_SIZE_32BIT=y
  mrubyc.integration.pool_nan_boxing:
    platform_allow: qemu_cortex_m3
    extra_configs:
      - CONFIG_MRUBYC_NAN_BOXING=y
      - CONFIG_TRAP_UNALIGNED_ACCESS=y
  mrubyc.integration.diagnostics:
    platform_allow: [native_sim, qemu_cortex_m3]
    extra_configs:
      - CONFIG_MRUBYC_ALLOC_PROFILING=y
      - CONFIG_MRUBYC_NO_STDIO=y
      - CONFIG_MRUBYC_DEBUG_REGS=y
      - CONFIG_MRUBYC_DISABLE_LEGACY_VALUE_MACROS=y
      - arch:posix:CONFIG_MRUBYC_CONVERT_CRLF=y
```

## west.yml
```yaml
manifest:
  projects:
    - name: zephyr
      url: https://github.com/zephyrproject-rtos/zephyr
      revision: v3.7.2
      clone-depth: 1
      import:
        name-allowlist:
          - cmsis
  self:
    path: modules/lib/mrubyc-zephyr
```

## zephyr/Kconfig
```kconfig
# SPDX-License-Identifier: BSD-3-Clause

menuconfig MRUBYC
	bool "mruby/c runtime"
	depends on MULTITHREADING && SYS_CLOCK_EXISTS && !SMP && !BIG_ENDIAN && !64BIT
	help
	  Build mruby/c and its Zephyr scheduler and console integration.
	  The application supplies a memory pool and starts the Ruby tasks.

if MRUBYC

config APP_LINK_WITH_MRUBYC_API
	bool
	default y

config MRUBYC_ALLOC_PROFILING
	bool "Memory pool profiling"
	help
	  Enable the mrbc_alloc_*_profiling() API. Ordinary allocations and
	  releases sample pool usage. Persistent allocations made at the pool
	  tail are reflected in the next sample.

config MRUBYC_OOM_POOL_STATS
	bool "Report mruby/c pool statistics on allocation failure"
	depends on PRINTK
	help
	  Print total, used, and free pool bytes before invoking the Zephyr
	  kernel panic. Otherwise the allocator prints only the error.

config MRUBYC_MAX_VM_COUNT
	int "Maximum simultaneous VMs"
	range 1 255
	default 5

config MRUBYC_MAX_REGS_SIZE
	int "Default registers per VM"
	range 32 65535
	default 110

config MRUBYC_MAX_SYMBOLS_COUNT
	int "Dynamic symbol table capacity"
	range 32 32512
	default 255

config MRUBYC_SYMBOL_SEARCH_LINEAR
	bool "Use linear search for dynamic symbols"
	help
	  Use linear search instead of the default binary tree. This saves
	  table storage, with slower lookups as the table grows.

choice MRUBYC_FLOAT
	prompt "Ruby Float representation"
	default MRUBYC_FLOAT_DOUBLE

config MRUBYC_FLOAT_SINGLE
	bool "Single precision"

config MRUBYC_FLOAT_DOUBLE
	bool "Double precision"

endchoice

config MRUBYC_USE_MATH
	bool "Math module"
	depends on NATIVE_LIBC || PICOLIBC || NEWLIB_LIBC || EXTERNAL_LIBC
	help
	  Enable the Ruby Math module. An external C library must provide libm.

config MRUBYC_USE_STRING_UTF8
	bool "UTF-8 character indexing"
	help
	  Index characters in UTF-8 strings in supported String methods.

config MRUBYC_USE_UNICODE_CASE
	bool "Unicode case conversion"
	depends on MRUBYC_USE_STRING_UTF8
	help
	  Enable Unicode Basic Multilingual Plane case conversion.

config MRUBYC_INT64
	bool "64-bit Ruby integers"

config MRUBYC_SUPPORT_OP_EXT
	bool "Extended bytecode operands"
	default y

config MRUBYC_INSTANCE_DESTRUCTOR
	bool "C instance destructor callbacks"
	default y
	help
	  Allow extensions to register instance destructors through
	  mrbc_define_destructor(). Disabling this changes the class layout
	  and removes the registration API.

config MRUBYC_EXCEPTION_CALL_NEST_LEVEL
	int "Maximum recorded exception frames"
	range 1 64
	default 8
	help
	  Number of call frames stored per exception for diagnostic output.

config MRUBYC_PANIC_ON_UNHANDLED_EXCEPTION
	bool "Panic when a Ruby exception escapes the VM"
	help
	  Print the exception when the VM ends and invoke a Zephyr kernel
	  panic. By default, the VM prints the exception and finishes its
	  own shutdown while the scheduler can continue running other tasks.

config MRUBYC_TASK_NAME_LEN
	int "Maximum task name length in bytes"
	range 1 255
	default 15
	help
	  Task names longer than this limit are truncated. The task control
	  block also reserves one byte for the terminating NUL.

config MRUBYC_KV_SIZE_INIT
	int "Initial key-value table capacity"
	range 1 64
	default 2
	help
	  Number of entries reserved when an empty key-value table first
	  needs storage, for example when setting an instance variable.

config MRUBYC_KV_SIZE_INCREMENT
	int "Key-value table growth increment"
	range 1 64
	default 5
	help
	  Number of extra entries to allocate when a key-value table fills.

config MRUBYC_NO_STDIO
	bool "Omit Ruby console methods"
	help
	  Omit p, print, puts, and printf. Keep sprintf for string formatting.
	  The HAL can still write runtime diagnostics.

config MRUBYC_CONVERT_CRLF
	bool "Convert console line feeds to CRLF in mruby/c"
	depends on !UART_CONSOLE
	help
	  Enable when the console expects CRLF and passes it through.
	  Zephyr's UART console already inserts carriage returns.

config MRUBYC_DEBUG_REGS
	bool "Log VM register usage on exit"
	help
	  Print register usage when a VM finishes.

config MRUBYC_DISABLE_LEGACY_VALUE_MACROS
	bool "Omit legacy C value macros"
	help
	  Hide legacy C value macros such as GET_INT_ARG and MRBC_TO_INT.
	  Use the mrbc_value accessors in C extensions.

config MRUBYC_TICK_UNIT_MS
	int "mruby/c timer period in milliseconds"
	range 1 10
	default 1
	help
	  Sets the scheduling and Ruby sleep resolution. Choose a period
	  that is an exact multiple of the Zephyr system clock tick.

config MRUBYC_TIMESLICE_TICK_COUNT
	int "Scheduler time slice in mruby/c ticks"
	range 1 255
	default 10
	help
	  Number of mruby/c ticks in a time slice. The time slice in
	  milliseconds is this value times the mruby/c timer period.

config MRUBYC_SCHEDULER_EXIT
	bool "Return from mrbc_run() when tasks drain"
	default y
	help
	  Return when there are no runnable, waiting, or suspended Ruby
	  tasks. Disable to keep the scheduler thread idle in that state.

endif # MRUBYC
```
